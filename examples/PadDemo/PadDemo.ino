/*
 */
 #include <Talkie.h>
Talkie voice;

const uint8_t spA[]             PROGMEM = {0x65,0x2C,0x96,0xAD,0x7B,0x6A,0x9F,0x66,0xE4,0x20,0x8D,0x9C,0x73,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0xFF,0x3F};
const uint8_t spB[]             PROGMEM = {0xA6,0x2F,0xAA,0x05,0x5C,0xD6,0x8C,0xBC,0xC7,0x16,0x70,0x59,0x33,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0xFF,0x03};
const uint8_t spC[]             PROGMEM = {0x04,0xF8,0xA5,0x83,0x03,0x12,0xB0,0x80,0x07,0x22,0xB0,0xC2,0xEE,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0xF3,0xFF};
const uint8_t spD[]             PROGMEM = {0x06,0x98,0x30,0x68,0xE4,0x6B,0x84,0xA0,0xE8,0xD3,0x93,0x8D,0xEC,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0xFF,0x0F};
const uint8_t spE[]             PROGMEM = {0xA2,0x59,0x95,0x51,0xBA,0x17,0xF7,0x6A,0x95,0xAB,0x38,0x42,0xE4,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0xFF,0x07};
const uint8_t spF[]             PROGMEM = {0xAB,0x1B,0x61,0x94,0xDD,0xD6,0xDC,0xF1,0x74,0xDD,0x37,0xB9,0xE7,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0xFF,0x07};
const uint8_t spG[]             PROGMEM = {0x6E,0x3F,0x29,0x8D,0x98,0x95,0xCD,0x3D,0x00,0xAB,0x38,0x95,0xE2,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0xF9,0x7F};
const uint8_t spH[]             PROGMEM = {0x65,0x18,0x6D,0x90,0x2D,0xD6,0xEC,0xF6,0x56,0xB7,0xBC,0xC5,0xAE,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0xFE,0x1F};
const uint8_t spI[]             PROGMEM = {0xAA,0x8D,0x63,0xA8,0xAA,0x66,0xAD,0xB9,0xA8,0xCB,0x08,0xDD,0x7C,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0xFE,0x7F};
const uint8_t spL[]             PROGMEM = {0x6B,0x68,0x2E,0xD8,0x2A,0x37,0xDF,0xFE,0xF6,0xA7,0xAF,0x21,0xBC,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0xFF,0x0F};
const uint8_t spJ[]             PROGMEM = {0x6E,0x5A,0xC1,0x99,0x54,0xB2,0x09,0x60,0x49,0x22,0x07,0xEC,0xA8,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0xFF,0x07};
const uint8_t spK[]             PROGMEM = {0x01,0x18,0x91,0xB9,0x00,0x4D,0x91,0x46,0x60,0x65,0x2D,0xB3,0xB8,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0xFF,0x01};
const uint8_t spM[]             PROGMEM = {0xA9,0xE8,0xC5,0xD8,0x73,0x16,0xCF,0xE2,0x0E,0xB7,0xBB,0xCD,0xA9,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0xFF,0x07};
const uint8_t spN[]             PROGMEM = {0x41,0xEE,0xD1,0xC8,0xB3,0x16,0xEF,0xEE,0xD4,0xC3,0x35,0x59,0xC4,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0xFF,0x01};
const uint8_t spO[]             PROGMEM = {0xA3,0x6D,0xB4,0xBA,0x8D,0xBC,0xAD,0xA6,0x92,0xEC,0x0E,0xF2,0xB6,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0xFF,0x01};
const uint8_t spP[]             PROGMEM = {0x02,0x88,0x26,0xD4,0x00,0x6D,0x96,0xB5,0xB8,0x25,0x05,0x89,0x6C,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0xFE,0x3F};
const uint8_t spQ[]             PROGMEM = {0x0E,0x98,0xD5,0x28,0x02,0x11,0x18,0xE9,0xCC,0x46,0x98,0xF1,0x66,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0xFF,0x0F};
const uint8_t spR[]             PROGMEM = {0xAB,0xC8,0x72,0x33,0x93,0xBB,0xDC,0xEE,0xB6,0xB7,0xB9,0xF5,0x68,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0xFD,0x3F};
const uint8_t spS[]             PROGMEM = {0x6B,0x6E,0xD9,0x34,0x6C,0xE6,0xDC,0xF6,0x36,0xB7,0xBE,0xF5,0x19,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0xF0,0xFF};
const uint8_t spT[]             PROGMEM = {0x01,0xD8,0xB6,0xDD,0x01,0x2F,0xF4,0x38,0x60,0xD5,0xD1,0x91,0x4D,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0xFF,0x07};
const uint8_t spU[]             PROGMEM = {0xA1,0x9F,0x9C,0x94,0x72,0x26,0x8D,0x76,0x07,0x55,0x90,0x78,0x3C,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0xFF,0x01};
const uint8_t spV[]             PROGMEM = {0x66,0xF3,0xD2,0x38,0x43,0xB3,0xD8,0x2D,0xAC,0x4D,0xBB,0x70,0xB0,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0xFF,0x03};
const uint8_t spW[]             PROGMEM = {0xA1,0xDE,0xC2,0x44,0xC2,0xFC,0x9C,0x6A,0x88,0x70,0x09,0x59,0x7B,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0xFF,0x07};
const uint8_t spX[]             PROGMEM = {0xAD,0x68,0xC9,0xC5,0x32,0x56,0xDF,0xFA,0x54,0x2D,0x35,0x7B,0xF8,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0xFE,0x1F};
const uint8_t spY[]             PROGMEM = {0x6A,0xB1,0xA2,0xA7,0x95,0xD2,0xD8,0x25,0x0F,0xA3,0x2D,0xB2,0x7A,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0xFA,0x7F};
const uint8_t spZ[]             PROGMEM = {0x6D,0xFD,0xC6,0x5C,0x95,0xD5,0xF5,0xD5,0x02,0x7B,0x5D,0xFD,0x51,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0xFE,0x1F};

const uint8_t spZERO[]      PROGMEM = {0xA2,0x2B,0x20,0x2D,0xAA,0x1A,0xAA,0xB6,0x81,0xD4,0x88,0x72,0xAC,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0x06,0x06};
const uint8_t spONE[]       PROGMEM = {0xCC,0x67,0x75,0x42,0x59,0x5D,0x3A,0x4F,0x9D,0x36,0x63,0xB7,0x59,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0xFF,0x0F};
const uint8_t spTWO[]       PROGMEM = {0x0E,0x38,0x6E,0x25,0x00,0xA3,0x0D,0x3A,0xA0,0x37,0xC5,0xA0,0x05,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0xFF,0x0F};
const uint8_t spTHREE[]     PROGMEM = {0x02,0xD8,0x2E,0x9C,0x01,0xDB,0xA6,0x33,0x60,0xFB,0x30,0x01,0xEC,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0xFF,0x0F};
const uint8_t spFOUR[]      PROGMEM = {0x0C,0x18,0xB6,0x9A,0x01,0xC3,0x75,0x09,0x60,0xD8,0x0E,0x09,0x30,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0xFF,0x07};
const uint8_t spFIVE[]      PROGMEM = {0x02,0xE8,0x3E,0x8C,0x01,0xDD,0x65,0x08,0x60,0x98,0x4C,0x06,0x34,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0xFE,0x7F};
const uint8_t spSIX[]       PROGMEM = {0x0E,0xD8,0xAE,0xDD,0x03,0x0E,0x38,0xA6,0xD2,0x01,0xD3,0xB4,0x2C,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0xFC,0x3F};
const uint8_t spSEVEN[]     PROGMEM = {0x02,0xB8,0x3A,0x8C,0x01,0xDF,0xA4,0x73,0x40,0x01,0x47,0xB9,0x2F,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0xF3,0xFF};
const uint8_t spEIGHT[]     PROGMEM = {0xC3,0x6C,0x86,0xB3,0x27,0x6D,0x0F,0xA7,0x48,0x99,0x4E,0x55,0x3C,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0xFE,0x1F};
const uint8_t spNINE[]      PROGMEM = {0xCC,0xA1,0x26,0xBB,0x83,0x93,0x18,0xCF,0x4A,0xAD,0x2E,0x31,0xED,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0xFF,0x07};


const uint8_t spCALIBRATE[]     PROGMEM = {0x0E,0x18,0xC9,0xD9,0x01,0x55,0x29,0x9E,0xA0,0x16,0x97,0x70,0x5F,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0xFF,0x0F};

const boolean serialdebugging = false; // send the processed data over serial console for serialdebugging instead of OSC
const boolean createkeypresses = false; // insert characters into keyboard stream
const boolean saykeypresses = true;

const int leftpin=4, toppin=3, bottompin=0,  rightpin=1;

void setup() {
analogReadResolution(13);
analogReadAveraging(4);

  Serial.begin(serialdebugging?9600:57600);
  voice.sayQ(spCALIBRATE);
  
}
const int dtime=40;

struct  padVoltages {  int l; int t; int r; int b; } ;

struct padVoltages padRead() {
      struct padVoltages r;
      r.l = analogRead(A7);   
      r.t = analogRead(A6); 
      r.b = analogRead(A11); 
      r.r = analogRead(A10); 
  return r;
}


void loop(){
  static int state = 0;
  struct padVoltages p;
 float x1, x2, y1, y2, z1, z2;


 
  if(dtime!=0)delay(dtime); // establish a settlement time before the read
    // this is to compensate for the potentially slow charge through the resistive material
    // to the input capacitor on the adc input.

pinMode(leftpin, INPUT); 
pinMode(rightpin, INPUT); 
pinMode(toppin, OUTPUT); digitalWrite(toppin, HIGH);
pinMode(bottompin, OUTPUT); digitalWrite(bottompin, LOW);

  p = padRead();
 p = padRead(); 

if(serialdebugging)
{Serial.println("raw X:top bottom left  right");
Serial.print(p.t); Serial.print(" ");
Serial.print(p.b); Serial.print(" ");
Serial.print(p.l); Serial.print(" ");
Serial.print(p.r); 
Serial.println();
}
 x1 = 100.0f * (p.l -p.b)/((float)p.t-p.b);
x2 = 100.0f * (p.r -p.b)/((float)p.t-p.b);
 x1 = (x1 - 12.0f)*(100.0f / (75.0f-12.0f));
 x2 = (x2 - 12.0f)*(100.0f / (75.0f-12.0f));
pinMode(toppin, INPUT); 
pinMode(bottompin, INPUT); 
pinMode(leftpin, OUTPUT); digitalWrite(leftpin, HIGH);
pinMode(rightpin, OUTPUT); digitalWrite(rightpin, LOW);

p = padRead(); 
 
 p = padRead(); 




if(serialdebugging)
{Serial.println("raw Y: left right top bottom");
Serial.print(p.l); Serial.print(" ");
Serial.print(p.r); Serial.print(" ");

Serial.print(p.t); Serial.print(" ");
Serial.print(p.b);
Serial.println(" ");
}
 y1 = (100.0f * (p.t -p.r)/((float)p.l-p.r) ); //  /10.0f/8.0f * - 20.0f
 y2 =  (100.0f * (p.b -p.r)/((float)p.l-p.r) );   // 10.0f/8.0f *- 20.0f

y1 = (y1-9.0f) * (100.0f/(95.0f-9.0f));
y2 = (y2-9.0f) * (100.0f/(95.0f-9.0f));
pinMode(bottompin, INPUT); 
pinMode(rightpin, INPUT); 
pinMode(toppin, OUTPUT); digitalWrite(toppin, HIGH);
pinMode(leftpin, OUTPUT); digitalWrite(leftpin, LOW);

p = padRead(); 
p = padRead(); 


if(p.b< 7900) //(7205))
{
  if(serialdebugging)Serial.print("Key "); Serial.println(state);
    const int nHoriz = 8,  nVertic = 3;
    int v = nVertic * (x1+x2) /2.0f / 100.0f ;
    int h = nHoriz *(y1+y2)/2.0f/100.0f;
    int index = h + nHoriz* v;
    if(true)
{Serial.print("y1 "); Serial.print(y1); Serial.print(" ");
Serial.print("y2 "); Serial.print(y2); Serial.print(" ");
Serial.print("x1 "); Serial.print(x1); Serial.print(" ");
Serial.print("x2 "); Serial.print(x2); Serial.println(" "); Serial.println("v h Index ");Serial.print(v); Serial.print(" ");Serial.print(h);Serial.print(" ");
Serial.println(index);
} 
 if(state==0)
 {
 
    //Keyboard
    if(saykeypresses)switch(index)
    {
      case 0: voice.sayQ(spA); break;
      case 1: voice.sayQ(spB); break;
      case 2: voice.sayQ(spC); break;
      case 3: voice.sayQ(spD); break;
      case 4: voice.sayQ(spE); break;
      case 5: voice.sayQ(spF); break;
      case 6: voice.sayQ(spG); break;
      case 7: voice.sayQ(spH); break;
      case 8: voice.sayQ(spI); break;
      case 9: voice.sayQ(spJ); break;
      case 10: voice.sayQ(spK); break;
      case 11: voice.sayQ(spL); break;
      case 12: voice.sayQ(spM); break;
      case 13: voice.sayQ(spN); break;
      case 14: voice.sayQ(spO); break;
      case 15: voice.sayQ(spP); break;
      case 16: voice.sayQ(spQ); break;
      case 17: voice.sayQ(spR); break;
      case 18: voice.sayQ(spS); break;
      case 19: voice.sayQ(spT); break;
      case 20: voice.sayQ(spU); break;
      case 21: voice.sayQ(spV); break;
      case 22: voice.sayQ(spW); break;
      case 23: voice.sayQ(spX); break;
      case 24: voice.sayQ(spY); break;
      case 25: voice.sayQ(spZ); break;
     case 26: voice.sayQ(spZERO); break;
      case 27: voice.sayQ(spONE); break;
      case 28: voice.sayQ(spTWO); break;
      case 29: voice.sayQ(spTHREE); break;
      case 30: voice.sayQ(spFOUR); break;
      case 31: voice.sayQ(spFIVE); break;
      case 32: voice.sayQ(spSIX); break;
      case 33: voice.sayQ(spSEVEN); break;
      case 34: voice.sayQ(spEIGHT); break;
      case 35: voice.sayQ(spNINE); break;
       default: voice.sayQ(spCALIBRATE); break;
    }
    if(createkeypresses)Keyboard.print("abcdefghijklmnopqrstuvwxyz0123456789"[index]);
 }
 state = 1;

}
else
  state = 0;
  

if(serialdebugging)
{Serial.println("raw Z: top left bottom right");
Serial.print(p.t); Serial.print(" ");
Serial.print(p.l); Serial.print(" ");
Serial.print(p.b); Serial.print(" ");
Serial.print(p.r); 
Serial.println(" ");
Serial.println(" ");Serial.println(" ");Serial.println(" ");
}
 }


